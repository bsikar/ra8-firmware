/* SPDX-License-Identifier: MIT
 * Copyright (c) 2026 Brighton Sikarskie
 *
 * CPU1 (Cortex-M33) image fragment, appended to the board map by
 * ra8_add_app(CPU1_IMAGE). Substituted from cpu1_memory_map.cmake.
 *
 * .cpu1_image carries an explicit address rather than a MEMORY region: the
 * board map's MEMORY block reaches this fragment by INCLUDE, and an INCLUDEd
 * MEMORY block cannot be amended by the script that includes it. An appended
 * SECTIONS block also gets no usable location counter from the board map, so
 * anything that must land at a fixed address has to say so itself.
 *
 * This lives in a file rather than in a generator string so that the two
 * symbols below are declared somewhere the linker-script checkers can read
 * them. While ereader_m33 still carried its own map, that fork was the only
 * tracked script defining them, and deleting it took LD006's only definition
 * with it (#742).
 */

SECTIONS
{
    .cpu1_image @RA8_CPU1_IMAGE_ORIGIN@ : ALIGN(4)
    {
        KEEP(*(.cpu1_image))
        KEEP(*(.cpu1_image.*))
    }
}

/* Where the M33 image is flashed; ra8_cpu1_release() starts the core here. */
g_ra8_ls_cpu1_mram_start = @RA8_CPU1_IMAGE_ORIGIN@;

/* The M33's initial SP, handed to ra8_cpu1_release() as `sp`. Equals the value
 * the M33's own linker_script_cpu1.ld computes, the top of SRAM_CPU1. */
g_ra8_ls_cpu1_stack_top  = @RA8_CPU1_STACK_TOP_EXPR@;

ASSERT(LOADADDR(.dtcm_data) + SIZEOF(.dtcm_data) <= @RA8_CPU1_IMAGE_ORIGIN@,
       "FATAL: the M85 image overran the CPU1 image window")
