## c6_firmware/sdkconfig.defaults
```kconfig
CONFIG_IDF_TARGET="esp32c6"
CONFIG_ESP_SPI_HOST_INTERFACE=y
CONFIG_SPI_HSPI=y
CONFIG_ESP_HOST_DEV_BOARD_NONE=y
CONFIG_ESP_SPI_HSPI_GPIO_CS=0
CONFIG_ESP_SPI_HSPI_GPIO_MOSI=1
CONFIG_ESP_SPI_HSPI_GPIO_MISO=2
CONFIG_ESP_SPI_HSPI_GPIO_CLK=3
CONFIG_ESP_SPI_GPIO_DATA_READY=4
CONFIG_ESP_SPI_GPIO_HANDSHAKE=6
CONFIG_ESP_SPI_GPIO_RESET=-1
CONFIG_ESPTOOLPY_FLASHSIZE_16MB=y
```
